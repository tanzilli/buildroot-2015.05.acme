## boot/acmeat91bootstrap/Config.in
```kconfig
config BR2_TARGET_ACMEAT91BOOTSTRAP
	bool "Acme AT91bootstrap 3.7"
	default y
	help
	  Build and install the Acme fork of AT91bootstrap target image, 
	  Atmel secondlevel bootloader. The image is named
	  boot.bin in output/images.
```

## configs/acme-xterm-01_defconfig
```kconfig
BR2_arm=y
BR2_ARM_INSTRUCTIONS_THUMB=y
BR2_TOOLCHAIN_EXTERNAL=y
BR2_TARGET_GENERIC_HOSTNAME="xterm-01"
BR2_TARGET_GENERIC_ISSUE="Welcome to XTERM-01 by Acme Systems !"
BR2_ROOTFS_DEVICE_CREATION_DYNAMIC_MDEV=y
BR2_TARGET_GENERIC_ROOT_PASSWD="acmesystems"
BR2_ROOTFS_OVERLAY="board/acmesystems/xterm-01/rootfs_overlay"
BR2_LINUX_KERNEL=y
BR2_LINUX_KERNEL_USE_CUSTOM_CONFIG=y
BR2_LINUX_KERNEL_CUSTOM_CONFIG_FILE="board/acmesystems/xterm-01/linux.config"
BR2_LINUX_KERNEL_ZIMAGE=y
BR2_LINUX_KERNEL_DTS_SUPPORT=y
BR2_LINUX_KERNEL_USE_CUSTOM_DTS=y
BR2_LINUX_KERNEL_CUSTOM_DTS_PATH="board/acmesystems/xterm-01/acme-arietta.dts"
BR2_PACKAGE_SDL=y
BR2_PACKAGE_SDL_MIXER=y
BR2_PACKAGE_SDL_NET=y
BR2_PACKAGE_QT=y
BR2_PACKAGE_QT_DEMOS=y
BR2_PACKAGE_QT_EXAMPLES=y
BR2_PACKAGE_QT_LICENSE_APPROVED=y
BR2_PACKAGE_QT_MOUSE_TSLIB=y
BR2_PACKAGE_PCRE=y
BR2_PACKAGE_PCRE_16=y
BR2_PACKAGE_PCRE_UTF=y
BR2_PACKAGE_OPENSSH=y
BR2_PACKAGE_NANO=y
BR2_PACKAGE_HOST_MKE2IMG=y
```
